## sdkconfig.defaults
```kconfig
# ESP-IDF sdkconfig defaults

# WiFi AP Configuration
CONFIG_WIFI_AP_SSID="ESP32-Turntable"
CONFIG_WIFI_AP_PASSWORD="12345678"
CONFIG_FIRMWARE_VERSION=1

# Enable WiFi
CONFIG_ESP_WIFI_ENABLED=y
CONFIG_ESP_WIFI_STATIC_RX_BUFFER_NUM=10
CONFIG_ESP_WIFI_DYNAMIC_RX_BUFFER_NUM=32
CONFIG_ESP_WIFI_DYNAMIC_TX_BUFFER_NUM=32

# Custom partition table
CONFIG_PARTITION_TABLE_CUSTOM=y
CONFIG_PARTITION_TABLE_CUSTOM_FILENAME="partitions.csv"

# SPIFFS filesystem
CONFIG_SPIFFS_MAX_PARTITIONS=3
CONFIG_SPIFFS_CACHE=y
CONFIG_SPIFFS_PAGE_SIZE=256
CONFIG_SPIFFS_OBJ_NAME_LEN=32
CONFIG_SPIFFS_USE_MAGIC=y
CONFIG_SPIFFS_USE_MTIME=y

# CPU frequency
CONFIG_ESP_DEFAULT_CPU_FREQ_MHZ_160=y

# Log level
CONFIG_LOG_DEFAULT_LEVEL_INFO=y

# SNTP
CONFIG_LWIP_SNTP_MAX_SERVERS=3

# HTTPS / mbedTLS certificate bundle (for Spotify API)
CONFIG_MBEDTLS_CERTIFICATE_BUNDLE=y
```

## src/Kconfig
```kconfig
menu "Turntable Configuration"

config WIFI_AP_SSID
    string "WiFi AP SSID"
    default "ESP32-Turntable"
    help
        SSID for the WiFi AP mode (config portal).

config WIFI_AP_PASSWORD
    string "WiFi AP Password"
    default "12345678"
    help
        Password for the WiFi AP mode. Must be at least 8 characters.

config FIRMWARE_VERSION
    int "Firmware version"
    default 1
    help
        Firmware version number. Changing this will trigger NVS clear on next boot.

endmenu
```
